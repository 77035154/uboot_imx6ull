## board/freescale/imx6ull_fxb_emmc/Kconfig
```kconfig
if TARGET_IMX6ULL_FXB_EMMC

config SYS_BOARD
	default "imx6ull_fxb_emmc"


config SYS_VENDOR
	default "freescale"

config SYS_SOC
        default "imx6"


config SYS_CONFIG_NAME
	default "imx6ull_fxb_emmc"

endif
```

## configs/imx6ull_fxb_emmc_defconfig
```kconfig
CONFIG_SYS_EXTRA_OPTIONS="IMX_CONFIG=board/freescale/imx6ull_fxb_emmc/imximage.cfg,MX6ULL_EVK_EMMC_REWORK"
CONFIG_ARM=y
CONFIG_ARCH_MX6=y
CONFIG_TARGET_IMX6ULL_FXB_EMMC=y
CONFIG_CMD_GPIO=y
```
